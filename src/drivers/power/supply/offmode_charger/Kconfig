## src/drivers/power/supply/offmode_charger/Kconfig
```kconfig
# SPDX-License-Identifier: GPL-2.0
#
# Kernel level off-mode (charger) UI
#
# Sourced from drivers/power/Kconfig so both options sit together at the
# "Device Drivers" level and are easy to find.
#

menu "Off-mode charger"
	depends on POWER_SUPPLY

config OFFMODE_CHARGER
	bool "Kernel level off-mode charger UI"
	depends on DRM_FBDEV_EMULATION
	depends on FB
	help
	  Run a minimal charging screen directly in the kernel when the
	  bootloader boots with androidboot.mode=charger.

	  Instead of starting init and letting the user space charger
	  service draw the screen, the kernel keeps the display alive,
	  polls the battery and charger power supplies, powers the
	  device off when the cable is removed and continues to boot
	  when the power key is held down.

	  Normal events are written to the kernel log and appended to
	  /data/adb/offmode_charger/driver.log and charger.log (the
	  files are written once /data has been mounted by init).

	  Say Y to replace the user space charger/charged service on
	  devices whose bootloader enters charger mode through the
	  kernel command line.  Say N otherwise.

	  This option only shows up after CONFIG_DRM_FBDEV_EMULATION has
	  been enabled: the msm DRM driver then registers the fbdev this
	  UI draws into (that symbol also selects CONFIG_FB).

config OFFMODE_CHARGER_DEBUG
	bool "OffModeCharger debug mode"
	depends on OFFMODE_CHARGER
	default n
	help
	  Enable debug messages for the off-mode charger driver.

	  Debug messages are written to the kernel log and to driver.log
	  and cover the driver internals:

	    - power supply lookups (name hit and type fallback),
	    - one line per 600 ms poll with capacity, status, battery
	      temperature, presence and charger online,
	    - power key events and the input device the handler bound to,
	    - every full redraw of the screen,
	    - every charge current change, including a failed FCC write.

	  Normal events (boot mode and command line, power supplies ready,
	  framebuffer, screen on/off, session progress and summary, and
	  all errors) are logged regardless of this option.

	  The debug messages are chatty - about 1.7 lines per second while
	  the charger UI runs - and fill the 32 KiB driver.log buffer
	  faster, so keep this disabled on production builds.

endmenu
```
